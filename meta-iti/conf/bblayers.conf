## meta-iti/conf/bblayers.conf
```bitbake
# POKY_BBLAYERS_CONF_VERSION is increased each time build/conf/bblayers.conf
# changes incompatibly
POKY_BBLAYERS_CONF_VERSION = "2"

BBPATH = "${TOPDIR}"
BBFILES ?= ""


#BBLAYERS[doc] = "Lists the layers to enable during the build. This variable is defined in the bblayers.conf configuration file."
BBLAYERS ?= " \
  /home/ahmed/poky/meta \
  /home/ahmed/poky/meta-poky \
  /home/ahmed/poky/meta-yocto-bsp \
  /home/ahmed/meta-raspberrypi \
  /home/ahmed/meta-iti \
  /home/ahmed/meta-openembedded/meta-networking \
  /home/ahmed/meta-openembedded/meta-python \
  /home/ahmed/meta-qt5 \

  
  "
```

## meta-iti/conf/distro/almaza.conf
```bitbake
include meta-poky/conf/distro/poky.conf


DISTRO = "almaza"
DISTRO_NAME = "almaza (Ahmed Abdalla)"
#DISTRO_VERSION = "3.4+snapshot-${METADATA_REVISION}"
DISTRO_VERSION = "1.0"
DISTRO_CODENAME = "kirkstone"

MAINTAINER = "ahmed.m.abdalla650@gmail.com"


#DISTRO_FEATURES:append = " x11 opengl wayland"
DISTRO_FEATURES:append = " x11 opengl wayland"
DISTRO_FEATURES:append = " bluez5 bluetooth wifi ipv4 systemd"

PACKAGECONFIG_FONTS:pn-qtbase = " fontconfig"

#==========================================================
PREFERRED_PROVIDER_virtual/java-initial-native = "cacao-initial-native"
PREFERRED_PROVIDER_virtual/java-native = "cacao-native"
PREFERRED_PROVIDER_virtual/javac-native = "ecj-bootstrap-native"
#==========================================================

INIT_MANAGER = "systemd"

# these 2 variables are the most important 
DISTRO_FEATURES:append = " systemd"
VIRTUAL-RUNTIME_init_manager = "systemd"

#we follwed that file /home/ahmed/poky/meta/conf/distro/include/init-manager-systemd.inc
DISTRO_FEATURES_BACKFILL_CONSIDERED:append = " sysvinit"
VIRTUAL-RUNTIME_initscripts = "systemd-compat-units"
VIRTUAL-RUNTIME_login_manager = "shadow-base"
VIRTUAL-RUNTIME_dev_manager = "systemd"

# Append Python packages to the existing image
#IMAGE_INSTALL_append = " python3 python3-pip python3-setuptools"
```

## meta-iti/conf/layer.conf
```bitbake
# We have a conf and classes directory, add to BBPATH
BBPATH .= ":${LAYERDIR}"

# We have recipes-* directories, add to BBFILES
#BBFILES[doc] = "List of recipe files used by BitBake to build software."
BBFILES += "${LAYERDIR}/recipes-*/*/*.bb \
            ${LAYERDIR}/recipes-*/*/*.bbappend"

BBFILE_COLLECTIONS += "meta-iti"
BBFILE_PATTERN_meta-iti = "^${LAYERDIR}/"
BBFILE_PRIORITY_meta-iti = "6"

LICENSE = "GPL-2.0-or-later"

LAYERDEPENDS_meta-iti = "core"
LAYERSERIES_COMPAT_meta-iti = "kirkstone"

ENABLE_UART = "1"

IMAGE_INSTALL += " qt-simple-calc"
```
